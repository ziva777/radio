#define RDY_PORT    PORTB
#define RDY_DDR     DDRB
#define RDY_PIN     PIN1

#define WR_PORT     PORTB
#define WR_DDR      DDRB
#define WR_PIN      PIN0

#define D7_PORT     PORTD
#define D7_DDR      DDRD
#define D7_PIN      PIN7

#define D6_PORT     PORTD
#define D6_DDR      DDRD
#define D6_PIN      PIN6

#define D5_PORT     PORTD
#define D5_DDR      DDRD
#define D5_PIN      PIN5

#define D4_PORT     PORTD
#define D4_DDR      DDRD
#define D4_PIN      PIN4

#define D3_PORT     PORTD
#define D3_DDR      DDRD
#define D3_PIN      PIN3

#define D2_PORT     PORTD
#define D2_DDR      DDRD
#define D2_PIN      PIN2

#define D1_PORT     PORTD
#define D1_DDR      DDRD
#define D1_PIN      PIN1

#define D0_PORT     PORTD
#define D0_DDR      DDRD
#define D0_PIN      PIN0

#define ENC_A_PORT  PORTC
#define ENC_A_DDR   DDRC
#define ENC_A_PIN   PIN0

#define ENC_B_PORT  PORTC
#define ENC_B_DDR   DDRC
#define ENC_B_PIN   PIN1

#define ENC_BTN_PORT PORTC
#define ENC_BTN_DDR  DDRC
#define ENC_BTN_PIN  PIN2

const uint8_t real_time_bit_image_seq2[] = { 0x02, 0x44 };
const uint8_t rA_seq[] = {0xFF, 0xFF, 0xFF, 0xFF, 0xFF, 0xFF, 0xFF, 0xFF};

#define BV(bit)     (1<<(bit))
#define cbi(reg,bit)  reg &= ~(BV(bit))
#define sbi(reg,bit)  reg |= (BV(bit))

#define VFD_SET_BIT(port, pin, bit) \
  do {                          \
    if ((bit))                  \
        sbi(port, pin);         \
    else                        \
        cbi(port, pin);         \
  } while (0)

static inline void vfd_send_seq_byte(uint8_t seq)
{
  int idx = 0;

  //Serial.println(seq, HEX);
  
  cbi(WR_PORT, WR_PIN);

  VFD_SET_BIT(D0_PORT, D0_PIN, (seq) & (1 << idx++));
  VFD_SET_BIT(D1_PORT, D1_PIN, (seq) & (1 << idx++));
  VFD_SET_BIT(D2_PORT, D2_PIN, (seq) & (1 << idx++));
  VFD_SET_BIT(D3_PORT, D3_PIN, (seq) & (1 << idx++));
  VFD_SET_BIT(D4_PORT, D4_PIN, (seq) & (1 << idx++));
  VFD_SET_BIT(D5_PORT, D5_PIN, (seq) & (1 << idx++));
  VFD_SET_BIT(D6_PORT, D6_PIN, (seq) & (1 << idx++));
  VFD_SET_BIT(D7_PORT, D7_PIN, (seq) & (1 << idx++));
  //_delay_us( 1 );

  sbi(WR_PORT, WR_PIN);
  _delay_us( 50 );
}

static inline void vfd_send_seq_array(const uint8_t *seq, int n)
{
  uint8_t chr;
  
  for ( int i = 0; i < n; i++ ) {
    chr = *((uint8_t*)seq + i);
    vfd_send_seq_byte(chr);
  }
}

static void draw_col(uint16_t pos)
{
  int x = pos * 8;
  int w = 8;
  vfd_send_seq_array(real_time_bit_image_seq2, sizeof(real_time_bit_image_seq2));
  vfd_send_seq_byte(0); // display address
  vfd_send_seq_byte(0x46);
  vfd_send_seq_byte(x & 0x00ff);
  vfd_send_seq_byte(x >> 8);
  vfd_send_seq_byte(w & 0x00ff);
  vfd_send_seq_byte(w >> 8);
  vfd_send_seq_array(rA_seq, w);
}

static void clear_col(uint16_t pos)
{
  int x = pos * 8;
  int w = 8;
  vfd_send_seq_array(real_time_bit_image_seq2, sizeof(real_time_bit_image_seq2));
  vfd_send_seq_byte(0); // display address
  vfd_send_seq_byte(0x46);
  vfd_send_seq_byte(x & 0x00ff);
  vfd_send_seq_byte(x >> 8);
  vfd_send_seq_byte(w & 0x00ff);
  vfd_send_seq_byte(w >> 8);

  for (int j = 0; j != w; ++j)
      vfd_send_seq_byte(0);
}


static void prepare(uint16_t pos, uint16_t size) {
  vfd_send_seq_array(real_time_bit_image_seq2, sizeof(real_time_bit_image_seq2));
  vfd_send_seq_byte(0); // display address
  vfd_send_seq_byte(0x46 );
  vfd_send_seq_byte(pos & 0xFF);
  vfd_send_seq_byte(pos >> 8);
  vfd_send_seq_byte(size & 0xFF);
  vfd_send_seq_byte(size >> 8);
}

static void print_byte(uint16_t x, uint8_t b)
{
  {
    int w;

    x *= 8;
    w = 1;
    vfd_send_seq_array( real_time_bit_image_seq2, sizeof(real_time_bit_image_seq2) );
    vfd_send_seq_byte( 0 ); // display address
    vfd_send_seq_byte( 0x46 );
    vfd_send_seq_byte( x & 0x00ff );
    vfd_send_seq_byte( x >> 8 );
    vfd_send_seq_byte( w & 0x00ff );
    vfd_send_seq_byte( w >> 8);

    vfd_send_seq_byte(b);
  }
  delay(10);
}

const uint8_t scale_data[] PROGMEM =
{
  0x00, 0x00, 0x00, 0x00, 0x00, 0x00, 0x00, 0x00,   
  0x00, 0x00, 0x00, 0x00, 0x00, 0x00, 0x00, 0x00,   
  0x00, 0x00, 0x00, 0x00, 0x00, 0x00, 0x00, 0x00,   
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  0x00, 0x00, 0x00, 0x00, 0x00, 0x00, 0x00, 0x00,   
};

const uint8_t font_1_digits_data[] PROGMEM =
{
  0x7F, 0xFF, 0x44,   
  0xFF, 0xFF, 0x9F,   
  0xFF, 0xFF, 0x80,   
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  0x7F, 0xFF, 0x7F,   
};

void setup() {
  /* Ecoder setup */
  sbi(ENC_A_PORT, ENC_A_PIN);
  cbi(ENC_A_DDR, ENC_A_PIN);

  sbi(ENC_B_PORT, ENC_B_PIN);
  cbi(ENC_B_DDR, ENC_B_PIN);

  sbi(ENC_BTN_PORT, ENC_BTN_PIN);
  cbi(ENC_BTN_DDR, ENC_BTN_PIN);
  
  /* Setup RDY pin */
  cbi(RDY_PORT, RDY_PIN);
  cbi(RDY_DDR, RDY_PIN);

  /* Setup RW pin */
  sbi(WR_PORT, WR_PIN);
  sbi(WR_DDR, WR_PIN);

  /* Setup DATA pin */
  sbi(D0_DDR, D0_PIN);
  sbi(D1_DDR, D1_PIN);
  sbi(D2_DDR, D2_PIN);
  sbi(D3_DDR, D3_PIN);
  sbi(D4_DDR, D4_PIN);
  sbi(D5_DDR, D5_PIN);
  sbi(D6_DDR, D6_PIN);
  sbi(D7_DDR, D7_PIN);

  /* Init display */
//  {
//    int x, w;
//
//    x = 0;
//    w = 512 * 8;
//    vfd_send_seq_array( real_time_bit_image_seq2, sizeof(real_time_bit_image_seq2) );
//    vfd_send_seq_byte( 0 ); // display address
//    vfd_send_seq_byte( 0x46 );
//    vfd_send_seq_byte( x & 0x00ff );
//    vfd_send_seq_byte( x >> 8 );
//    vfd_send_seq_byte( w & 0x00ff );
//    vfd_send_seq_byte( w >> 8);
//
//    for (int j = 0; j != w; ++j)
//      vfd_send_seq_byte(0);
//  }
//  delay(10);
  {
    int x, w;

    x = 0;
    w = 256 * 8;
    vfd_send_seq_array( real_time_bit_image_seq2, sizeof(real_time_bit_image_seq2) );
    vfd_send_seq_byte( 0 ); // display address
    vfd_send_seq_byte( 0x46 );
    vfd_send_seq_byte( x & 0x00ff );
    vfd_send_seq_byte( x >> 8 );
    vfd_send_seq_byte( w & 0x00ff );
    vfd_send_seq_byte( w >> 8);

    for (int j = 0; j != w; ++j)
      vfd_send_seq_byte(pgm_read_word(&scale_data[j]));
  }

  delay(10);
};

static uint8_t pos = 0;
static uint8_t old_pos = 0;
//static uint8_t *frame;
static bool forward = true;

static void switch_screen(void)
{
  static bool tick = true;

  vfd_send_seq_byte(0x02);
  vfd_send_seq_byte(0x44);
  vfd_send_seq_byte(0);
  vfd_send_seq_byte(0x53);

  if (tick)
  {
    vfd_send_seq_byte( 0x0800 & 0x00ff );
    vfd_send_seq_byte( 0x0800 >> 8 );
  }
  else
  {
    vfd_send_seq_byte( 0x00 & 0x00ff );
    vfd_send_seq_byte( 0x00 >> 8 );
  }

  tick = !tick;
}

void loop() {
  //switch_screen();
  //delay(15);
  return;
  int pos;

  if (forward)
    pos = 0x0800;
  else
    pos = 0x0;
  forward = !forward;

  vfd_send_seq_byte(0x02);
  vfd_send_seq_byte(0x44);
  vfd_send_seq_byte(0);
  vfd_send_seq_byte(0x53);
  vfd_send_seq_byte( pos & 0x00ff );
  vfd_send_seq_byte( pos >> 8 );
  delay(1000);
  return;
  {
    int x, w;

//    frame = malloc(2048);
//    memset(frame, 0, sizeof(frame));
    x = 256;
    w = 256 * 8;
    vfd_send_seq_array( real_time_bit_image_seq2, sizeof(real_time_bit_image_seq2) );
    vfd_send_seq_byte( 0 ); // display address
    vfd_send_seq_byte( 0x46 );
    vfd_send_seq_byte( x & 0x00ff );
    vfd_send_seq_byte( x >> 8 );
    vfd_send_seq_byte( w & 0x00ff );
    vfd_send_seq_byte( w >> 8);

    for (int j = 0; j != w; ++j)
      vfd_send_seq_byte(pgm_read_word(&scale_data[j]));
  }
  //return;

  
  int w;

  if (forward)
    pos = (pos + 1) % 256;
  else
    pos = (pos - 1) % 256;
  w = 16;
  vfd_send_seq_array( real_time_bit_image_seq2, sizeof(real_time_bit_image_seq2) );
  vfd_send_seq_byte( 0 ); // display address
  vfd_send_seq_byte( 0x46 );
  vfd_send_seq_byte( pos*8 & 0x00ff );
  vfd_send_seq_byte( pos*8 >> 8 );
  vfd_send_seq_byte( w & 0x00ff );
  vfd_send_seq_byte( w >> 8);

  if (forward) {
    for (int j = 0; j != 8; ++j)
      vfd_send_seq_byte(0);
    for (int j = 0; j != 8; ++j)
      vfd_send_seq_byte(0xFF);
  } else {
    for (int j = 0; j != 8; ++j)
      vfd_send_seq_byte(0xFF);
    for (int j = 0; j != 8; ++j)
      vfd_send_seq_byte(0);
  }

  if (pos == 255)
    forward = !forward;
    
  delay(100);
}
